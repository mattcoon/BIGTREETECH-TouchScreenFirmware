/**
 * Icon Keywords Generation
 * Usage: X_ICON(VALUE)
 * 'VALUE' is the keyword name without the 'ICON_'
 *
 * Description: https://en.wikipedia.org/wiki/X_Macro
 *
 * After changing/adding/removing an icon, change the ICON_FLASH_SIGN in Settings.h
 */

X_ICON (MOVE)
X_ICON (HOME)
X_ICON (DISABLE_STEPPERS)
X_ICON (PRINT)
X_ICON (EXTRUDE)
X_ICON (FAN)
X_ICON (SETTINGS)
X_ICON (LEVELING)
X_ICON (LEVEL_CORNER)
X_ICON (Z_FADE)
X_ICON (INC)
X_ICON (DEC)
X_ICON (APPLY)
X_ICON (STOP)
X_ICON (BACK)
X_ICON (X_INC)
X_ICON (Y_INC)
X_ICON (Z_INC)
X_ICON (001_MM)
X_ICON (01_MM)
X_ICON (1_MM)
X_ICON (10_MM)
X_ICON (100_MM)
X_ICON (X_DEC)
X_ICON (Y_DEC)
X_ICON (Z_DEC)
X_ICON (X_HOME)
X_ICON (Y_HOME)
X_ICON (Z_HOME)
X_ICON (FOLDER)
X_ICON (FILE)
X_ICON (PAGE_UP)
X_ICON (PAGE_DOWN)
X_ICON (PAUSE)
X_ICON (RESUME)
X_ICON (SLOW_SPEED)
X_ICON (NORMAL_SPEED)
X_ICON (FAST_SPEED)
X_ICON (E_1_PERCENT)
X_ICON (E_5_PERCENT)
X_ICON (E_10_PERCENT)
X_ICON (FAN_FULL_SPEED)
X_ICON (FAN_HALF_SPEED)
X_ICON (ROTATE_UI)
X_ICON (LANGUAGE)
X_ICON (TOUCHSCREEN_ADJUST)
X_ICON (MORE)
X_ICON (SCREEN_INFO)
X_ICON (DISCONNECT)
X_ICON (BAUD_RATE)
X_ICON (PERCENTAGE)
X_ICON (BABYSTEP)
X_ICON (ONBOARD_SD)
X_ICON (ONTFT_SD)
X_ICON (USB_DISK)
X_ICON (POINT_1)
X_ICON (POINT_2)
X_ICON (POINT_3)
X_ICON (POINT_4)
X_ICON (POINT_5)
X_ICON (MARLIN_MODE)
X_ICON (TOUCH_MODE)
X_ICON (GCODE)
X_ICON (BLTOUCH)
X_ICON (SCREEN_SETTINGS)
X_ICON (MACHINE_SETTINGS)
X_ICON (FEATURE_SETTINGS)
X_ICON (PROBE_OFFSET)
X_ICON (EEPROM_SAVE)
X_ICON (EEPROM_RESTORE)
X_ICON (EEPROM_RESET)
X_ICON (SOUND)
X_ICON (SHUT_DOWN)
X_ICON (RGB_SETTINGS)
X_ICON (RGB_RED)
X_ICON (RGB_GREEN)
X_ICON (RGB_BLUE)
X_ICON (RGB_WHITE)
X_ICON (RGB_OFF)
X_ICON (CUSTOM)
X_ICON (MANUAL_LEVEL)
X_ICON (PARAMETER)
X_ICON (RESET_VALUE)
X_ICON (PRINTING_FAN)
X_ICON (PRINTING_TIMER)
X_ICON (PRINTING_ZLAYER)
X_ICON (PRINTING_SPEED)
X_ICON (PRINTING_FLOW)
X_ICON (PRINTING_XPOS)
X_ICON (PRINTING_YPOS)
X_ICON (PRINTING_ZPOS)
X_ICON (MAINMENU)
X_ICON (HOME_MOVE)
X_ICON (STATUS_FAN)
X_ICON (STATUS_SPEED)
X_ICON (STATUS_FLOW)
X_ICON (LEVEL_EDGE_DISTANCE)
X_ICON (CONNECTION_SETTINGS)
X_ICON (Z_ALIGN)
X_ICON (BRIGHTNESS)
X_ICON (DELTA_CALIBRATE)
X_ICON (LASER)
X_ICON (LASER_2)
X_ICON (LASER_100)
X_ICON (LASER_OFF)
X_ICON (SPINDLE)
X_ICON (ZERO_X)
X_ICON (ZERO_Y)
X_ICON (ZERO_Z)
X_ICON (NOT_X)
X_ICON (NOT_Y)
X_ICON (NOT_Z)
X_ICON (NOT_01_MM)
X_ICON (NOT_1_MM)
X_ICON (NOT_10_MM)
X_ICON (NOT_100_MM)

// After changing/adding/removing an icon, change the ICON_FLASH_SIGN in Settings.h

#define ICON_NOZZLE ICON_NULL
#define ICON_BED ICON_NULL
#define ICON_CHAMBER ICON_NULL
#define ICON_LOAD ICON_NULL
#define ICON_UNLOAD ICON_NULL
#define ICON_PREHEAT_BOTH ICON_NULL
#define ICON_PREHEAT ICON_NULL
#define ICON_HEAT_FAN ICON_NULL
#define ICON_STATUS_NOZZLE ICON_NULL
#define ICON_STATUS_BED ICON_NULL
#define ICON_STATUS_CHAMBER ICON_NULL
